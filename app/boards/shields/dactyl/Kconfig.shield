## app/boards/shields/dactyl/Kconfig.shield
```kconfig
config DACTYL_LEFT
    def_bool $(shields_list_contains,dactyl_left)

config DACTYL_RIGHT
    def_bool $(shields_list_contains,dactyl_right)
```
